/* arch/arm/boot/dts/qcom/msm8996-tone-dora-common.dtsi
 *
 * This program is free software; you can redistribute it and/or modify
 * it under the terms of the GNU General Public License version 2 and
 * only version 2 as published by the Free Software Foundation.
 *
 * This program is distributed in the hope that it will be useful,
 * but WITHOUT ANY WARRANTY; without even the implied warranty of
 * MERCHANTABILITY or FITNESS FOR A PARTICULAR PURPOSE.  See the
 * GNU General Public License for more details.
 */
/*
 * Copyright (C) 2015 Sony Mobile Communications Inc.
 *
 * This program is free software; you can redistribute it and/or modify
 * it under the terms of the GNU General Public License version 2, as
 * published by the Free Software Foundation.
 */

&soc {
	/* I2C : BLSP12 */
	i2c@75ba000 {
		synaptics_clearpad@2c {
			wakeup_gesture_use_workaround_for_felica = <1>;
			/* chip settings */
			S332U {
				calibrate_on_fwflash = <0>;
			};
		};
	};

	somc_pinctrl: somc_pinctrl@0 {
		pinctrl-0 = <&msm_gpio_4
				&msm_gpio_5 &msm_gpio_6 &msm_gpio_7 &msm_gpio_8 &msm_gpio_9
				&msm_gpio_10 &msm_gpio_11 &msm_gpio_12 &msm_gpio_13
				&msm_gpio_14 &msm_gpio_15 &msm_gpio_16 &msm_gpio_17
				&msm_gpio_18 &msm_gpio_19 &msm_gpio_20 &msm_gpio_21
				&msm_gpio_22 &msm_gpio_23 &msm_gpio_24 &msm_gpio_25
				&msm_gpio_26 &msm_gpio_27 &msm_gpio_28 &msm_gpio_29
				&msm_gpio_30 &msm_gpio_31 &msm_gpio_32 &msm_gpio_33
				&msm_gpio_34 &msm_gpio_38 &msm_gpio_39 &msm_gpio_40
				&msm_gpio_41 &msm_gpio_42 &msm_gpio_43 &msm_gpio_44_suspend
				&msm_gpio_45 &msm_gpio_46 &msm_gpio_47 &msm_gpio_48
				&msm_gpio_49 &msm_gpio_50 &msm_gpio_51 &msm_gpio_52
				&msm_gpio_55 &msm_gpio_56 &msm_gpio_57 &msm_gpio_58
				&msm_gpio_59 &msm_gpio_60 &msm_gpio_61 &msm_gpio_62
				&msm_gpio_63 &msm_gpio_69 &msm_gpio_73 &msm_gpio_74
				&msm_gpio_75 &msm_gpio_76 &msm_gpio_77 &msm_gpio_78
				&msm_gpio_79 &msm_gpio_81 &msm_gpio_82_suspend &msm_gpio_83
				&msm_gpio_84 &msm_gpio_85 &msm_gpio_87
				&msm_gpio_88 &msm_gpio_89 &msm_gpio_90 &msm_gpio_91
				&msm_gpio_92 &msm_gpio_93 &msm_gpio_94 &msm_gpio_95
				&msm_gpio_96 &msm_gpio_108 &msm_gpio_112 &msm_gpio_116
				&msm_gpio_120 &msm_gpio_121 &msm_gpio_122 &msm_gpio_123
				&msm_gpio_124 &msm_gpio_125 &msm_gpio_126 &msm_gpio_130
				&msm_gpio_131 &msm_gpio_132 &msm_gpio_141 &msm_gpio_142
				&msm_gpio_143>;
	};
};

i2c_3: i2c@7577000 { /* BLSP1 QUP2 */
		pinctrl-0 = <&msm_gpio_47 &msm_gpio_48>;
		pinctrl-1 = <&msm_gpio_47 &msm_gpio_48>;
};

&tlmm {
	/* GPIO_47 : NC */
	msm_gpio_47: msm_gpio_47 {
		mux {
			pins = "gpio47";
			function = "gpio";
		};

		config {
			pins = "gpio47";
			drive-strength = <2>;
			bias-disable;
			output-low;
		};
	};

	/* GPIO_48 : NC */
	msm_gpio_48: msm_gpio_48 {
		mux {
			pins = "gpio48";
			function = "gpio";
		};

		config {
			pins = "gpio48";
			drive-strength = <2>;
			bias-disable;
			output-low;
		};
	};
};


&somc_pinctrl {
	/* If variant specific default setting is needed,
	   fill pinctrl-1 value in <variant>.dtsi */
	pinctrl-1 = <&msm_gpio_25 &msm_gpio_47 &msm_gpio_47_suspend
		&msm_gpio_48 &msm_gpio_48_suspend
		&msm_gpio_59 &msm_gpio_60 &msm_gpio_61 &msm_gpio_78
		&msm_gpio_85_suspend &msm_gpio_86_suspend &msm_gpio_104
		&msm_gpio_127 &msm_gpio_131>;
};

/{
	tone_dora_batterydata: qcom,battery-data {
		#include "batterydata-tone-dora-send.dtsi"
	};
};

&qpnp_fg {
	qcom,battery-data = <&tone_dora_batterydata>;
	qcom,fg-iterm-ma = <150>;
	qcom,fg-chg-iterm-ma = <150>;
	qcom,cold-hot-jeita-hysteresis = <20 20>;
	somc,cool-warm-jeita-hysteresis = <20 20>;
};

&qpnp_smbcharger {
	qcom,fastchg-current-ma = <1800>;
	somc,usb-9v-current-max = <1700>;
	qcom,float-voltage-comp = <0x05>;
	somc,fastchg-warm-current-ma = <800>;
	somc,fastchg-cool-current-ma = <800>;
	somc,thermal-engine-fastchg-current = <1800 1800 1800 1400 1000 700 500 300 300 300 300 300 300 0 0>;
	somc,thermal-mitigation-usb-5v = <1500 1500 1500 1500 1500 1500 1500 1500 1200 900 700 500 300 0 0>;
	somc,thermal-mitigation-usb-6v = <2300 2300 2300 2300 1500 1500 1500 1500 1200 900 700 500 300 0 0>;
	somc,thermal-mitigation-usb-7v = <2000 2000 2000 2000 1200 1200 1200 1200 1200 900 700 500 300 0 0>;
	somc,thermal-mitigation-usb-8v = <1800 1800 1800 1800 1100 1100 1100 1100 1200 900 700 500 300 0 0>;
	somc,thermal-mitigation-usb-9v = <1600 1600 1600 1600 1000 1000 1000 1000 1200 900 700 500 300 0 0>;
	somc,limit-usb-5v-level = <8>;
};

&spmi_bus {
	pmi8994@3 {
		qcom,leds@d000 {
			status = "okay";
			qcom,rgb_sync = <1>;

			qcom,rgb_0 {
				somc,pwm-channel = <2>;
				linux,name = "led:rgb_red";
				/delete-property/ linux,default-trigger;
				somc,color_variation_max_num = <1>;
				somc,max_current = <0 320 320>;
				qcom,start-idx = <0>;
				qcom,idx-len = <8>;
				qcom,lut-flags = <31>;
				qcom,pause-lo = <500>;
				qcom,pause-hi = <500>;
				qcom,ramp-step-ms = <200>;
				qcom,duty-pcts = [00 0E 1C 2A 38 46 54 64];
				qcom,use-blink;
			};
			qcom,rgb_1 {
				somc,pwm-channel = <1>;
				linux,name = "led:rgb_green";
				/delete-property/ linux,default-trigger;
				somc,color_variation_max_num = <1>;
				somc,max_current = <0 511 511>;
				qcom,start-idx = <0>;
				qcom,idx-len = <8>;
				qcom,lut-flags = <31>;
				qcom,pause-lo = <500>;
				qcom,pause-hi = <500>;
				qcom,ramp-step-ms = <200>;
				qcom,duty-pcts = [00 0E 1C 2A 38 46 54 64];
				qcom,use-blink;
			};
			qcom,rgb_2 {
				somc,pwm-channel = <0>;
				linux,name = "led:rgb_blue";
				/delete-property/ linux,default-trigger;
				somc,color_variation_max_num = <1>;
				somc,max_current = <0 511 224>;
				qcom,start-idx = <0>;
				qcom,idx-len = <8>;
				qcom,lut-flags = <31>;
				qcom,pause-lo = <500>;
				qcom,pause-hi = <500>;
				qcom,ramp-step-ms = <200>;
				qcom,duty-pcts = [00 0E 1C 2A 38 46 54 64];
				qcom,use-blink;
			};
		};
		qcom,leds@d800 {
			qcom,fs-curr-ua = <20000>;
			qcom,led-strings-list = [00 01 02];
			somc,init-br-ua = <10000>;
			somc-s1,br-power-save-ua = <800>;
			qcom,ilim-ma = <660>;
		};
	};
};

&usb3 {
	id_polling_use;
	id_polling_up_interval = <2000>;
	id_polling_up_period = <500>;
	id_polling_pd_gpio = <&tlmm 24 0>;
	qcom,usb_detect-vadc = <&pm8994_vadc>;
	somc,usb_detect_adc_channel = <0x39>;
	somc,disable-typec-otg;

   /*  ***** Kept for hardware capability reference ***** */
//	usb_switch_sel = <&pmi8994_gpios 9 0>;
//	usb_id_discharge = <&pmi8994_mpps 1 0>;
};

&pm8994_vadc {
	chan@39 {
		label = "usb_detect";
		reg = <0x39>;
		qcom,decimation = <0>;
		qcom,pre-div-channel-scaling = <0>;
		qcom,calibration-type = "absolute";
		qcom,scale-function = <0>;
		qcom,hw-settle-time = <5>;
		qcom,fast-avg-setup = <0>;
	};
};
